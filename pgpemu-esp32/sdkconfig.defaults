## pgpemu-esp32/sdkconfig.defaults
```kconfig
# Override some defaults so BT stack is enabled
# in this example

CONFIG_BT_ENABLED=y
CONFIG_BT_GATTS_ENABLE=y
CONFIG_BT_BLUEDROID_ENABLED=y
CONFIG_BT_NIMBLE_ENABLED=n
CONFIG_BT_CONTROLLER_MODE_BLE_ONLY=y

# Heltec WiFi Kit 32 uses 26 MHz crystal (not 40 MHz)
CONFIG_XTAL_FREQ_26=y
CONFIG_XTAL_FREQ=26
CONFIG_ESP32_XTAL_FREQ_26=y
CONFIG_ESP32_XTAL_FREQ=26

# Enable FreeRTOS trace facility for vTaskList support
CONFIG_FREERTOS_USE_TRACE_FACILITY=y
CONFIG_FREERTOS_USE_STATS_FORMATTING_FUNCTIONS=y
```
